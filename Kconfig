## Kconfig
```kconfig
mainmenu "dragonRTOS Configuation"

menu "General"
	config ARCH
		int "CONFIG ARCH riscv32 = 1, riscv64 = 2, arm32 = 3, arm64 = 4"
		default 1
		range 1 4
		help
			riscv32 = 1, riscv64 = 2, arm32 = 3, arm64 = 4

	config CROSS_COMPILE
		string "cross compile path"

	source "arch/Kconfig"
	source "platform/Kconfig"
endmenu

menu "Kernel"
	source "kernel/Kconfig"
endmenu

menu "MCU"
	source "mcu/Kconfig"
endmenu

menu "Memory"
	source "memory/Kconfig"
endmenu

menu "App"
	source "apps/Kconfig"
endmenu
```

## apps/Kconfig
```kconfig
menu "App"
	config APP_START_ADDR
	hex "app start address"
	default 0x80004000

	config APP_LEN
	hex "app length"
	default 0x2000

	config APP_MAIN_STACK_LEN
	hex "app length"
	default 0x400
endmenu
```

## arch/riscv32/Kconfig
```kconfig
menu "BootConfig"
	config BOOT_START_ADDR
	hex "boot start address"
	default 0x00000000

	config BOOT_LEN
	hex "boot length"
	default 0x1000
endmenu
```

## kernel/Kconfig
```kconfig
menu "KernelConfig"
	config KERNEL_START_ADDR
	hex "kernel start address"
	default 0x80002000

	config KERNEL_LEN
	hex "kernel length"
	default 0x2000

	config KERNEL_STACK_LEN
	hex "kernel stack length"
	default 0x400
endmenu
```

## mcu/arm32/Kconfig
```kconfig
choice
	prompt "MCU"
	help
		"select one mcu"

	config STM32F103
	bool "stm32f103"
	config STM32F407
	bool "stm32f407"
endchoice
```

## mcu/riscv32/Kconfig
```kconfig
choice
	prompt "MCU"
	help
		"select one mcu"

	config SIFIVE_E31
	bool "sifive_e31"
	config QEMU_VIR32
	bool "qemu_vir32"
	config QEMU_VIR_TEST
	bool "qemu_vir_test"
endchoice
```

## memory/Kconfig
```kconfig
config STACK_SIZE
hex "stack size"
default 0x400

# config HEAP_SIZE
# hex "heap size default 4096"
# default 0x1000
```
